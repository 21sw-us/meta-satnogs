## conf/layer.conf
```bitbake
# We have a conf and classes directory, add to BBPATH
BBPATH .= ":${LAYERDIR}"

# We have recipes-* directories, add to BBFILES
BBFILES += "${LAYERDIR}/recipes-*/*/*.bb \
            ${LAYERDIR}/recipes-*/*/*.bbappend"

BBFILE_COLLECTIONS += "satnogs"
BBFILE_PATTERN_satnogs = "^${LAYERDIR}/"
BBFILE_PRIORITY_satnogs = "9"

LAYERDEPENDS_satnogs = "core"
LAYERSERIES_COMPAT_satnogs = "dunfell gatesgarth"
LAYERDEPENDS_satnogs = "core openembedded-layer sdr-layer meta-amateurradio"
HOSTTOOLS += "docker"
```
